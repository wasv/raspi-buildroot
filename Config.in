## Config.in
```kconfig
source "$BR2_EXTERNAL_RPI_ZW_MIN_PATH/packages/python-mopidy/Config.in"
source "$BR2_EXTERNAL_RPI_ZW_MIN_PATH/packages/python-mopidy-jellyfin/Config.in"
source "$BR2_EXTERNAL_RPI_ZW_MIN_PATH/packages/python-mopidy-alsamixer/Config.in"
source "$BR2_EXTERNAL_RPI_ZW_MIN_PATH/packages/python-mopidy-musicbox-webclient/Config.in"
source "$BR2_EXTERNAL_RPI_ZW_MIN_PATH/packages/python-pykka/Config.in"
source "$BR2_EXTERNAL_RPI_ZW_MIN_PATH/packages/python-unidecode/Config.in"
```

## packages/python-mopidy-alsamixer/Config.in
```kconfig
config BR2_PACKAGE_PYTHON_MOPIDY_ALSAMIXER
	bool "python-mopidy-alsamixer"
	select BR2_PACKAGE_PYTHON_MOPIDY # runtime
	select BR2_PACKAGE_PYTHON_PYKKA # runtime
	select BR2_PACKAGE_PYTHON_SETUPTOOLS # runtime
	select BR2_PACKAGE_PYTHON_ALSAAUDIO # runtime
	help
	  Mopidy extension for ALSA volume control

	  https://github.com/mopidy/mopidy-alsamixer
```

## packages/python-mopidy-jellyfin/Config.in
```kconfig
config BR2_PACKAGE_PYTHON_MOPIDY_JELLYFIN
	bool "python-mopidy-jellyfin"
	select BR2_PACKAGE_PYTHON_MOPIDY # runtime
	select BR2_PACKAGE_PYTHON_PYKKA # runtime
	select BR2_PACKAGE_PYTHON_REQUESTS # runtime
	select BR2_PACKAGE_PYTHON_SETUPTOOLS # runtime
	select BR2_PACKAGE_PYTHON_UNIDECODE # runtime
	select BR2_PACKAGE_PYTHON_WEBSOCKET_CLIENT # runtime
	help
	  Mopidy extension for playing music from jellyfin.

	  https://github.com/jellyfin/mopidy-jellyfin
```

## packages/python-mopidy-musicbox-webclient/Config.in
```kconfig
config BR2_PACKAGE_PYTHON_MOPIDY_MUSICBOX_WEBCLIENT
	bool "python-mopidy-musicbox-webclient"
	select BR2_PACKAGE_PYTHON_MOPIDY # runtime
	select BR2_PACKAGE_PYTHON_PYKKA # runtime
	select BR2_PACKAGE_PYTHON_SETUPTOOLS # runtime
	help
	  Mopidy MusicBox web extension

	  https://github.com/jellyfin/mopidy-musicbox-webclient
```

## packages/python-mopidy/Config.in
```kconfig
config BR2_PACKAGE_PYTHON_MOPIDY
	bool "python-mopidy"
	select BR2_PACKAGE_PYTHON_PYKKA # runtime
	select BR2_PACKAGE_PYTHON_REQUESTS # runtime
	select BR2_PACKAGE_PYTHON_SETUPTOOLS # runtime
	select BR2_PACKAGE_PYTHON_TORNADO # runtime
	help
	  Mopidy is an extensible music server written in Python

	  https://mopidy.com
```
